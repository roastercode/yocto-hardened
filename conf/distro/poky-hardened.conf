## conf/distro/poky-hardened.conf
```bitbake
# Distro hardened — hérite de poky et renforce la sécurité
require conf/distro/poky.conf

DISTRO = "poky-hardened"
DISTRO_NAME = "Poky Hardened"
DISTRO_VERSION = "1.0"

# CVE checking sur tous les paquets
INHERIT += "cve-check"

# Pas de debug-tweaks par défaut sur toutes les images
DISTRO_FEATURES:remove = "x11"
IMAGE_FEATURES:remove = "debug-tweaks"

# Forcer le mot de passe root vide interdit
ROOTFS_POSTPROCESS_COMMAND:append = " zap_empty_root_password;"

# SELinux
DISTRO_FEATURES:append = " selinux"
PREFERRED_PROVIDER_virtual/refpolicy = "refpolicy-targeted"
# PAM — nécessaire pour Slurm et l'authentification HPC
DISTRO_FEATURES:append = " pam"

# Ajouter Gentoo aux distros validées pour supprimer le warning
SANITY_TESTED_DISTROS:append = " gentoo-2.18 \n "
```

## conf/layer.conf
```bitbake
# SPDX-License-Identifier: MIT
#
# yocto-hardened-hpc — Hardened embedded Linux layer for HPC and space
# applications. Provides FTRFS (radiation-robust filesystem), Slurm HPC
# stack, and a reference arm64 cluster image validated on kernel 7.0.
#
# Maintainer: Aurelien DESBRIERES <aurelien@hackers.camp>
# Repository: https://github.com/roastercode/yocto-hardened
# Branch:     arm64-ftrfs

BBPATH .= ":${LAYERDIR}"

BBFILES += "${LAYERDIR}/recipes-*/*/*.bb \
            ${LAYERDIR}/recipes-*/*/*.bbappend"

BBFILE_COLLECTIONS += "yocto-hardened-hpc"
BBFILE_PATTERN_yocto-hardened-hpc = "^${LAYERDIR}/"
BBFILE_PRIORITY_yocto-hardened-hpc = "6"

LAYERVERSION_yocto-hardened-hpc = "1"
LAYERSERIES_COMPAT_yocto-hardened-hpc = "scarthgap styhead"

LAYERDEPENDS_yocto-hardened-hpc = "core"
LAYERRECOMMENDS_yocto-hardened-hpc = "meta-oe"
```
